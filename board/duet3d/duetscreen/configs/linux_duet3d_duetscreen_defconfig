## configs/duet3d_duetscreen_spinand_defconfig
```kconfig
BR2_arm=y
BR2_cortex_a7=y
BR2_ARM_FPU_VFPV4=y
BR2_TOOLCHAIN_EXTERNAL=y
BR2_TOOLCHAIN_EXTERNAL_GDB_SERVER_COPY=y
BR2_TARGET_GENERIC_HOSTNAME="duetscreen"
BR2_TARGET_GENERIC_ISSUE="Welcome to Duet3D DuetScreen (SPINAND build)"
BR2_ROOTFS_DEVICE_CREATION_DYNAMIC_EUDEV=y
BR2_ROOTFS_OVERLAY="board/duet3d/duetscreen/rootfs_overlay"
BR2_ROOTFS_POST_BUILD_SCRIPT="board/duet3d/duetscreen/scripts/post-build.sh"
BR2_ROOTFS_POST_IMAGE_SCRIPT="support/scripts/genimage.sh"
BR2_ROOTFS_POST_SCRIPT_ARGS="-c board/duet3d/duetscreen/scripts/genimage-spinand.cfg sun8i-t113 sun8i-duet3d-duetscreen-linux.dtb"
BR2_LINUX_KERNEL=y
BR2_LINUX_KERNEL_CUSTOM_GIT=y
BR2_LINUX_KERNEL_CUSTOM_REPO_URL="https://github.com/chrishamm/linux.git"
BR2_LINUX_KERNEL_CUSTOM_REPO_VERSION="40ff75350940a6d880940cf04df0ca5e7277c95d"
BR2_LINUX_KERNEL_USE_CUSTOM_CONFIG=y
BR2_LINUX_KERNEL_CUSTOM_CONFIG_FILE="board/duet3d/duetscreen/configs/linux/linux_duet3d_duetscreen_defconfig"
BR2_LINUX_KERNEL_DTS_SUPPORT=y
BR2_LINUX_KERNEL_CUSTOM_DTS_PATH="board/duet3d/duetscreen/dts/linux/sun8i-duet3d-duetscreen-linux.dts"
BR2_PACKAGE_ALSA_UTILS=y
BR2_PACKAGE_ALSA_UTILS_AMIXER=y
BR2_PACKAGE_ALSA_UTILS_SPEAKER_TEST=y
BR2_PACKAGE_FFMPEG=y
BR2_PACKAGE_FFMPEG_SWSCALE=y
BR2_PACKAGE_GDB=y
BR2_PACKAGE_E2FSPROGS=y
BR2_PACKAGE_E2FSPROGS_RESIZE2FS=y
BR2_PACKAGE_MTD=y
BR2_PACKAGE_DUETSCREEN=y
BR2_PACKAGE_EVTEST=y
BR2_PACKAGE_PARTED=y
BR2_PACKAGE_RTL8188FU=y
BR2_PACKAGE_USBMOUNT=y
BR2_PACKAGE_LIBPNG=y
BR2_PACKAGE_LIBGPIOD=y
BR2_PACKAGE_LIBGPIOD_TOOLS=y
BR2_PACKAGE_LIBUSB=y
BR2_PACKAGE_MDNSD=y
# BR2_PACKAGE_MDNSD_SSH_SERVICE is not set
BR2_PACKAGE_LIBEVDEV=y
BR2_PACKAGE_CRDA=y
BR2_PACKAGE_DHCPCD=y
BR2_PACKAGE_DROPBEAR=y
BR2_PACKAGE_GESFTPSERVER=y
BR2_PACKAGE_IW=y
BR2_PACKAGE_NTP=y
BR2_PACKAGE_WPA_SUPPLICANT=y
BR2_PACKAGE_WPA_SUPPLICANT_WPA3=y
BR2_PACKAGE_WPA_SUPPLICANT_CLI=y
BR2_PACKAGE_WPA_SUPPLICANT_PASSPHRASE=y
BR2_PACKAGE_ANDROID_TOOLS=y
BR2_PACKAGE_HTOP=y
BR2_PACKAGE_UTIL_LINUX_KILL=y
BR2_PACKAGE_UTIL_LINUX_MOUNT=y
BR2_PACKAGE_UTIL_LINUX_RFKILL=y
BR2_PACKAGE_NANO=y
# BR2_TARGET_ROOTFS_TAR is not set
BR2_TARGET_ROOTFS_UBI=y
BR2_TARGET_ROOTFS_UBI_SUBSIZE=2048
BR2_TARGET_ROOTFS_UBIFS_LEBSIZE=0x20000
BR2_TARGET_ROOTFS_UBIFS_RT_NONE=y
BR2_TARGET_UBOOT=y
BR2_TARGET_UBOOT_BUILD_SYSTEM_KCONFIG=y
BR2_TARGET_UBOOT_CUSTOM_GIT=y
BR2_TARGET_UBOOT_CUSTOM_REPO_URL="https://github.com/chrishamm/u-boot.git"
BR2_TARGET_UBOOT_CUSTOM_REPO_VERSION="tina-2018.05"
BR2_TARGET_UBOOT_USE_CUSTOM_CONFIG=y
BR2_TARGET_UBOOT_CUSTOM_CONFIG_FILE="board/duet3d/duetscreen/configs/uboot/uboot_duet3d_duetscreen_spinand_defconfig"
BR2_TARGET_UBOOT_NEEDS_PYLIBFDT=y
BR2_TARGET_UBOOT_NEEDS_OPENSSL=y
BR2_TARGET_UBOOT_FORMAT_CUSTOM=y
BR2_TARGET_UBOOT_FORMAT_CUSTOM_NAME="u-boot-sun8iw20p1.bin"
BR2_TARGET_UBOOT_CUSTOM_DTS_PATH="board/duet3d/duetscreen/dts/uboot/.board-uboot.dts board/duet3d/duetscreen/dts/linux/sun8i-duet3d-duetscreen-linux.dts"
BR2_PACKAGE_HOST_E2FSPROGS=y
BR2_PACKAGE_HOST_GENIMAGE=y
BR2_PACKAGE_HOST_MTOOLS=y
BR2_PACKAGE_HOST_PYTHON3=y
BR2_PACKAGE_HOST_PYTHON3_SSL=y
BR2_PACKAGE_HOST_UBOOT_TOOLS=y
```

## package/duetscreen/Config.in
```kconfig
config BR2_PACKAGE_DUETSCREEN
	bool "duetscreen"
	depends on BR2_INSTALL_LIBSTDCPP
	depends on !BR2_STATIC_LIBS
	depends on BR2_TOOLCHAIN_HAS_THREADS
	depends on BR2_USE_WCHAR
	depends on BR2_TOOLCHAIN_GCC_AT_LEAST_8 # C++20
	select BR2_HOST_CMAKE_AT_LEAST_3_30
	select BR2_PACKAGE_SDL2
	select BR2_PACKAGE_SPDLOG
	select BR2_PACKAGE_FMT
	select BR2_PACKAGE_SOCAT
	select BR2_PACKAGE_LIBUSB_COMPAT
	select BR2_PACKAGE_MUSL_FTS if !BR2_TOOLCHAIN_USES_GLIBC
	select BR2_PACKAGE_WPA_SUPPLICANT_WPA_CLIENT_SO
	select BR2_PACKAGE_FREETYPE
	select BR2_PACKAGE_LIBXKBCOMMON
	select BR2_PACKAGE_XKEYBOARD_CONFIG
	help
	  Display application for Duet3D DuetScreen devices

	  DuetScreen is an application using LVGL to display various
	  information about Duet3D controllers using RepRapFirmware.

	  https://www.duet3d.com
```

## package/rtl8188fu/Config.in
```kconfig
config BR2_PACKAGE_RTL8188FU
	bool "rtl8188fu"
	depends on !BR2_s390x
	depends on BR2_LINUX_KERNEL
	help
	  A standalone driver for the RTL8188FU USB Wi-Fi adapter.
	  This is needed only for Linux kernels before 3.12.
	  Since 3.12, there is a (staging) driver in mainline, with a
	  similar codebase.

	  Make sure your target kernel has the CONFIG_WIRELESS_EXT
	  config option enabled.

	  Note: this package needs a firmware loading mechanism to load
	  the binary blob for the chip to work.

	  https://github.com/kelebek333/rtl8188fu

comment "rtl8188fu needs a Linux kernel to be built"
	depends on !BR2_s390x
	depends on !BR2_LINUX_KERNEL
```
